## drivers/misc/muic/Kconfig
```kconfig
#
# MUIC devices
#

comment "MUIC configs"

config SM5504_MUIC
	bool "SILICON MITUS MUIC"
	default n
	help
	  This option enables SILICON MITUS MUIC.

config MUIC_SUPPORT_AUDIO_DOCK
	bool "MUIC_SUPPORT_AUDIO_DOCK"
	default n
	help
	  If you say yes here you will get support for the audio dock.

config MUIC_SUPPORT_DESK_DOCK
	bool "MUIC_SUPPORT_DESK_DOCK"
	default n
	help
	  If you say yes here you will get support for the desk dock.

config MUIC_SUPPORT_SMART_DOCK
	bool "MUIC_SUPPORT_SMART_DOCK"
	default n
	help
	  If you say yes here you will get support for the smart dock.

config MUIC_SUPPORT_MMD_CTL
	bool "MUIC_SUPPORT_MMD_CTL"
	default n
	help
	  If you say yes here you will get support for the smart dock enable func by keystring.

config MUIC_SUPPORT_LANHUB
	bool "MUIC_SUPPORT_LANHUB"
	depends on !SEC_FACTORY
	default n
	help
	  If you say yes here, you will get support for the LANHUB cable.

config MUIC_SUPPORT_RUSTPROOF
	bool "MUIC Disable UART"
	depends on !SEC_FACTORY
	default n
	help
	 This option will disable the UART to prevent the rusting of the
	 IF Connector in the case of Kmini Devices.

config MUIC_SUPPORT_RUSTPROOF_INBATT
	bool "MUIC Disable UART IN SUSPEND"
	depends on !SEC_FACTORY
	default n
	help
	 This option will muic path open in the suspend
	 this is for only in-battery model

config MUIC_SUPPORT_CHARGING_CABLE
	bool "MUIC CHARGING CABLE SUPPORT"
	default n
	help
	 This option will enable the Charging (Power sharing) Cable

config MUIC_SUPPORT_INCOMPATIBLE_CHARGER
	bool "MUIC_SUPPORT_INCOMPATIBLE_CHARGER"
	default n
	help
	  If you say yes here you will get support for the incompatible charger.

config MUIC_SUPPORT_VZW_INCOMPATIBLE
	bool "MUIC VZW INCOMPATIBLE CHARGER SUPPORT"
	default n
	help
	 This option will enable the Incompatible Charger for VZW requirement

config USBID_STANDARD
	bool "USBID_STANDARD"
	default n
	help
	  If you say yes here you will get support for usbid standard.

config USBID_STANDARD_VER_01
	bool "USBID STANDARD VER 01"
	default n
	help
	  This option enables USBID STANDARD.
```

## drivers/platform/samsung/Kconfig
```kconfig
# Samsung configuration options

config MACH_SAMSUNG
	bool "Samsung device"
	depends on ARCH_MSM
	help
	  Support for Samsung products

menu "Samsung project family selection"

config SEC_GT58_PROJECT
	bool "Samsung GT5 8 Project"
	depends on ARCH_MSM8916
	select MACH_SAMSUNG
	help
	  Support for Samsung GT5 8 Project

config SEC_GT510_PROJECT
	bool "Samsung GT5 10 Project"
	depends on ARCH_MSM8916
	select MACH_SAMSUNG
	help
	  Support for Samsung GT5 8 Project

endmenu

menu "Samsung board selection"

config MACH_GT58WIFI_EUR_OPEN
	bool "Samsung GT5 8 WIFI EUR Open"
	depends on SEC_GT58_PROJECT
	help
	  Support for Samsung GT5 8 WIFI EUR Open device.

config MACH_GT510WIFI_EUR_OPEN
	bool "Samsung GT5 10 WIFI EUR Open"
	depends on SEC_GT510_PROJECT
	help
	  Support for Samsung GT5 10 WIFI EUR Open device.

endmenu

menu "Samsung features"

config EXTEND_SERIAL_NUM_16
	bool "Extended serial number (16 digits)"
	default n

endmenu
```

## drivers/power/samsung/Kconfig
```kconfig
config BATTERY_SAMSUNG
	tristate "samsung battery driver"
	help
	  Say Y to include support for samsung battery driver
	  This battery driver integrated all battery-related functions
	  To see battery-related functions,
	  refer to sec_charging_common.h

config BATTERY_SAMSUNG_DATA_FILE
	depends on BATTERY_SAMSUNG
	string "samsung battery data file"
	default "default_battery_data.h"
	help
	  Path to the battery data file.

config SLOW_CHARGING_CURRENT_STANDARD
	int "slow charging"
	depends on BATTERY_SAMSUNG
	default "1000"
	help
	  Value for standard of slow-charging.

config CHARGING_VZWCONCEPT
	tristate "VZW concept about the charging"
	default n
	depends on BATTERY_SAMSUNG
	help
	  Say Y to include support for the VZW concepts.

config BATTERY_SWELLING
	bool "prevent battery swelling"
	help
	  Say Y to include support for prevent battery swelling

config BATTERY_SWELLING_SELF_DISCHARGING
	bool "prevent battery swelling with self discharging"
	help
	  Say Y to include support for prevent battery swelling with self discharging

config PREVENT_SOC_JUMP
	tristate "prevent soc jump at full-charged"
	default n
	depends on BATTERY_SAMSUNG
	help
	  Say Y to prevent soc jump

config SAMSUNG_LPM_MODE
	bool "Off charging mode support in sec battery driver"
	default n
	help
	  Say Y to include support for sec off charging support
	  This value defined at bootloader.
	  Before enable this feature,
	  implemet power off charging in the bootloader.

config SAMSUNG_BATTERY_ENG_TEST
	bool "enable ENG mode for battery test"
	default n
	help
	  Say Y to include support for battery test
	  enable this feature only ENG mode
	  this featuren must disabled user binary
	  stability test etc..

config SAMSUNG_BATTERY_FACTORY
	bool "enable for factory test"
	default n
	help
	  Say Y to include support for factory test
	  enable this feature only factory mode
	  this featuren must disabled user binary
	  stability test etc..

config SAMSUNG_BATTERY_DISALLOW_DEEP_SLEEP
	bool "Disallow deep sleep during charging"
	default n
	depends on BATTERY_SAMSUNG && (ARCH_MSM8974 || ARCH_APQ8084)
	help
	  Say Y to include support
	  Disallow deep sleep during charging for stablity.

config DISABLE_SAVE_CAPACITY_MAX
	bool "Disable to save capacity max in efs"
	default n
	depends on BATTERY_SAMSUNG
	help
	  Say Y to include support to disable it
	  capacity_max is saved in /efs/Battery/batt_capacity_max
	  capacity_max is restored after boot up
	  You can find the code in healthd

config SIOP_CHARGING_LIMIT_CURRENT
	int "Siop charging limit current"
	default 0
	help
	  set SIOP charging limit current.

config EN_OOPS
	bool "enable oops filter"
	default n
	help
	  Say Y to enable oops filter

# Fuel Gauge
config FUELGAUGE_DUMMY
	tristate "dummy fuel gauge driver"
	default n
	depends on BATTERY_SAMSUNG
	help
	  Say Y to include support
	  for dummy fuel gauge driver.
	  This driver source code implemented
	  skeleton source code for fuel gauge functions.

config FUELGAUGE_MAX77849
	tristate "MAX77849 fuel gauge driver"
	default n
	depends on BATTERY_SAMSUNG
	help
	  Say Y to include support
	  It is based on the MAX17050 fuel gauge driver.
	  This fuel-gauge can be used in voltage-tracking mode
	  or coulomb-counting mode.

config FUELGAUGE_MAX77849_VOLTAGE_TRACKING
	tristate "use MAX77849 fuel gauge only as voltage tracking"
	default n
	depends on FUELGAUGE_MAX77849
	help
	  Say Y to use MAX77849 fuel gauge
	  only as voltage tracking.
	  This mode is for target that consumes low current
	  like smart-phone.

config FUELGAUGE_MAX77849_COULOMB_COUNTING
	tristate "use MAX77849 fuel gauge as coulomb counting (including voltage tracking)"
	default n
	depends on FUELGAUGE_MAX77849
	help
	  Say Y to use MAX77849 fuel gauge
	  as coulomb counting (including voltage tracking).
	  This mode is for target that consumes high current
	  like tablet.

# Charger
config CHARGER_DUMMY
	tristate "dummy charger driver"
	default n
	depends on BATTERY_SAMSUNG
	help
	  Say Y to include support
	  for dummy charger driver.
	  This driver source code implemented
	  skeleton source code for charger functions.

config CHARGER_MAX77849
        tristate "MAX77849 battery charger support"
        depends on MFD_MAX77849 && I2C
        help
          Say Y here to enable support for the MAX77849 charger
          MAX77849 incluse muic, pmic, haptic, led,
          flash driver.
          You have to define MFD_MAX77849
```

## drivers/sensors/Kconfig
```kconfig
menuconfig SENSORS
	bool "Sensor devices"
	help
	  Say Y here, and a list of sensors drivers will be displayed.
	  Everything that didn't fit into the other categories is here. This option
	  doesn't affect the kernel.

	  If unsure, say Y.

config SENSORS_CORE
	bool "Sensors Core Support"
	depends on MACH_SAMSUNG
	help
	  This option enables the sensor sysfs class in /sys/class/sensors.
	  You'll need this to do anything useful with sensorss. If unsure, say N.

config SENSORS_CLASS
	bool "Sensors Class Support"
	depends on !MACH_SAMSUNG
	help
	  This option enables the sensor sysfs class in /sys/class/sensors.
	  You'll need this to do anything useful with sensorss. If unsure, say N.

config SENSORS_SSC
	bool "Enable Sensors Driver Support for SSC"
	help
	  Add support for sensors SSC driver.
	  This driver is used for exercising sensors use case,
	  time syncing with ADSP clock.
```

## drivers/video/msm/mdss/samsung/Kconfig
```kconfig
config FB_MSM_MDSS_SAMSUNG
	depends on MACH_SAMSUNG && FB_MSM_MDSS
	bool "mdss config for samsung product"
	default n
	---help---
	  Mdss config signature for samsung product

config DUAL_PANEL
	depends on FB_MSM_MDSS_SAMSUNG
	bool "dual paneloperation"
	default n
	---help---
	  dual panel operation support

config PARTIAL_UPDATE
	depends on FB_MSM_MDSS_SAMSUNG
	bool "partial update operation"
	default n
	---help---
	  partial update operation support

config ALPM_MODE
	depends on FB_MSM_MDSS_SAMSUNG
	bool "alpm mode operation"
	default n
	---help---
	  alpm mode operation support

config CABC_FUNCTION
	depends on FB_MSM_MDSS_SAMSUNG
	bool "DDI cabc operation"
	default n
	---help---
	  DDI cabc operation support

config SAMSUNG_DEBUG_DISPLAY
	depends on FB_MSM_MDSS_SAMSUNG
        bool "Add Samsung Debugging code"
        default n

menu "Samsung panel selection"

config PANEL_S6D7AA0_LSL080AL03_WXGA
	depends on FB_MSM_MDSS_SAMSUNG
	bool "SDC S6D7AA0 LDI"
	default n

config PANEL_S6D7AA0_LTL101AT01_WXGA
	depends on FB_MSM_MDSS_SAMSUNG
	bool "SDC S6D7AA0 LDI"
	default n

endmenu
```
